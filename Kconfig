## Kconfig
```kconfig
# SPDX-License-Identifier: Apache-2.0
# SynapticOS Kconfig

# Library-only gcov instrumentation. Global CONFIG_COVERAGE cannot
# fit qemu_cortex_m3 (the instrumented image overflows flash by
# ~245 KB and RAM by ~128 KB), so this instruments ONLY the
# synaptic_os library and reuses Zephyr's embedded gcov runtime and
# console dump. Harvest with tools/syn_coverage.sh.
config SYNAPTIC_COVERAGE
    bool "gcov-instrument the SynapticOS library"
    depends on !NATIVE_BUILD
    select FORCE_COVERAGE
    select COVERAGE
    select COVERAGE_DUMP

config SYNAPTIC_COVERAGE_FILES
    string "src/core file globs to instrument (space-separated)"
    depends on SYNAPTIC_COVERAGE
    default "*.c"
    help
      Counter RAM scales with instrumented code, and 64 KB QEMU
      targets cannot always afford all of src/core next to the test
      fixtures (tests/unit_store carries an 18 KB RAM flash). Each
      coverage app narrows this to the files its suites exercise;
      gcovr merges the runs into one report.

menuconfig SYNAPTIC
    bool "SynapticOS AI Runtime"
    depends on SOC_SERIES_MCXNX4X || BOARD_QEMU_CORTEX_M3
    select CRC
    help
      Enable the SynapticOS AI-native runtime for inference
      scheduling, tensor memory management, and NPU orchestration.
      CRC support is selected for model integrity checks (CRC32 on
      registry commits and every model load).

if SYNAPTIC

config SYNAPTIC_TENSOR_ARENA_SIZE
    int "Tensor arena size in bytes"
    default 131072
    range 4096 524288
    help
      Size of the SRAM region dedicated to tensor allocations.
      Default 128 KB. Adjust based on model requirements.

config SYNAPTIC_SCRATCH_POOL_SIZE
    int "Scratch pool size in bytes"
    default 16384
    range 1024 65536
    help
      Size of the reusable scratch buffer pool for per-layer
      intermediate computations.

config SYNAPTIC_MAX_MODELS
    int "Maximum number of registered models"
    default 4
    range 1 16
    help
      Maximum number of models that can be registered in the
      model registry simultaneously.

config SYNAPTIC_MAX_CONCURRENT_JOBS
    int "Maximum concurrent inference jobs"
    default 2
    range 1 4
    help
      Maximum number of inference jobs that can be queued
      or running concurrently.

config SYNAPTIC_MAX_PIPELINE_STAGES
    int "Maximum stages per inference pipeline"
    default 8
    range 4 16
    help
      Maximum number of stages (preprocess + model + postprocess)
      in a single inference pipeline.

config SYNAPTIC_LAYER_EXEC
    bool "Layer-granular execution and preemption"
    default y
    help
      Execute models in the synthetic layered format (magic "SYNL")
      one layer at a time, letting the scheduler preempt a
      preemptible job at a layer boundary when a higher-priority job
      arrives and resume it later from saved context. Costs a live
      context, a scratch buffer and two suspension slots, each
      SYNAPTIC_LAYER_ACT_MAX bytes plus a small header.

config SYNAPTIC_LAYER_ACT_MAX
    int "Layered-model activation buffer size in bytes"
    depends on SYNAPTIC_LAYER_EXEC
    default 1024
    range 64 4096
    help
      Largest single activation (layer output) a layered model may
      produce.

config SYNAPTIC_LAYER_PLAN_MAX
    int "Layered-model activation plan area size in bytes"
    depends on SYNAPTIC_LAYER_EXEC
    default 2048
    range 128 16384
    help
      Size of the shared activation plan area all live activations
      of a layered model are placed into (memory-optimal placement,
      Phase 5.2). Must hold the planned peak of the deepest model in
      use; sessions whose planned peak exceeds it are rejected at
      begin. Also sets the size of each of the two suspension slots.

config SYNAPTIC_HEALTH
    bool "Health monitor and watchdog integration"
    default y
    help
      Production-hardening core: registered software sources must
      check in within their period while busy; a 100 ms monitor
      thread feeds the hardware watchdog (when CONFIG_WATCHDOG is
      enabled and the board has a watchdog0 alias) only while all
      sources are fresh, reports stale sources through a fault
      callback otherwise, and on dual-core CPU0 builds recovers a
      hung CPU1 by parking and re-releasing it.

config SYNAPTIC_WATCHDOG_TIMEOUT_MS
    int "Hardware watchdog timeout in milliseconds"
    depends on SYNAPTIC_HEALTH && WATCHDOG
    default 2000
    range 500 60000
    help
      Reset fires this long after the health monitor last considered
      every source fresh. Must comfortably exceed the health tick
      (100 ms) plus the longest legitimate scheduling gap.

config SYNAPTIC_CPU1_HANG_MS
    int "CPU1 heartbeat loss threshold in milliseconds"
    depends on SYNAPTIC_HEALTH && SYNAPTIC_DUAL_CORE
    default 500
    range 200 10000
    help
      CPU1 ticks a shared-memory heartbeat every 100 ms. When the
      counter stalls this long while the link is up, CPU0 parks and
      re-releases CPU1 (the OTA park/resume machinery).

config SYNAPTIC_NEUTRON
    bool "Use the eIQ Neutron NPU (requires the optional eIQ module)"
    depends on SOC_SERIES_MCXNX4X && !SOC_MCXN947_CPU1
    select FPU
    select FPU_SHARING if MULTITHREADING
    help
      Drive the eIQ Neutron NPU through NXP's precompiled
      libNeutronDriver/libNeutronFirmware. Those libraries are
      LA_OPT-licensed and are NOT part of this repository; enable the
      optional west group and fetch them from NXP's public repository
      first:
        west config manifest.group-filter -- +neutron
        west update mcuxsdk-middleware-eiq
      Models must be compiled ahead of time with neutron-converter
      (LiteRT/TFLite input). When disabled, the NPU HAL keeps the
      stub passthrough behavior and the build is identical to a
      pre-Neutron tree.

config SYNAPTIC_NEUTRON_CTX_MAX
    int "Neutron model context buffer size in bytes"
    depends on SYNAPTIC_NEUTRON
    default 4096
    range 256 32768
    help
      Static buffer handed to neutronModelPrepare as the model
      context, sized by neutronGetModelContextSize at load time
      (loads needing more are rejected with a log telling you to
      raise this). Keeps the driver off the heap entirely.

config SYNAPTIC_NEUTRON_SCRATCH_SIZE
    int "Neutron scratch buffer size in bytes"
    depends on SYNAPTIC_NEUTRON
    default 16384
    range 1024 262144
    help
      Static scratch buffer passed to every neutronRunBlocking call
      for intermediate tensors. The required size is model-specific;
      size it from the neutron-converter memory report of the
      largest deployed model. A NULL buffer would make the driver
      allocate from the heap, which this HAL never does.

config SYNAPTIC_POWERQUAD
    bool "Use PowerQuad hardware acceleration"
    depends on SOC_SERIES_MCXNX4X
    default y
    help
      Route FFT and Q15 matrix operations through the PowerQuad
      coprocessor. Init runs known-answer self-calibration and
      falls back to the software kernels per-operation if it fails.

config SYNAPTIC_PROFILING
    bool "Enable inference profiling"
    default y if DEBUG
    help
      Enable per-inference profiling of execution time, memory
      usage, and NPU utilization. Zero overhead when disabled.

config SYNAPTIC_MODEL_STORE
    bool "Flash-backed model store"
    default y if !SOC_MCXN947_CPU1
    help
      Persist the model registry across reboots: two ping-pong
      registry copies (generation + CRC32, newest valid wins) plus
      A/B model slots, all accessed through a narrow flash port.
      On the FRDM-MCXN947 the store lives in the bank 1 tail above
      the CPU1 image reserve; on QEMU a RAM-backed port emulates
      the flash so the logic is fully unit-testable.

config SYNAPTIC_STORE_AUTO_INIT
    bool "Initialize the model store automatically at boot"
    depends on SYNAPTIC_MODEL_STORE
    default y
    help
      On boards with the MCX ROM-API flash HAL, bring the model
      store up over the generated partition map before main() so
      persistent models reappear without application code. Runs
      before CPU1 release; a failure only disables persistence.
      QEMU targets have no backing flash and initialize a RAM port
      explicitly instead.

config SYNAPTIC_OTA
    bool "Enable OTA model updates"
    depends on SYNAPTIC_MODEL_STORE
    default y
    help
      Enable over-the-air model update support using dual-bank
      flash with A/B slot management.

config SYNAPTIC_DUAL_CORE
    bool "Enable dual-core operation"
    depends on SECOND_CORE_MCUX
    default y
    help
      Enable asymmetric dual-core operation where CPU0 runs the
      AI runtime and CPU1 runs the application.

config SYNAPTIC_IPC_RING_SIZE
    int "IPC ring buffer entry count"
    default 16
    range 4 64
    depends on SYNAPTIC_DUAL_CORE
    help
      Number of entries in the inter-core IPC ring buffer.

config SYNAPTIC_SHARED_REGION_SIZE
    int "Shared memory region size in bytes"
    default 98304
    depends on SYNAPTIC_DUAL_CORE
    help
      Size of the shared SRAM region for IPC and tensor exchange
      between CPU0 and CPU1. Default 96 KB.

config SYNAPTIC_MPU_PROTECT
    bool "Cross-core MPU protection support"
    depends on SYNAPTIC_DUAL_CORE && ARM_MPU
    default y
    help
      Runtime support for cross-core memory protection: a fault
      policy that logs MPU violations and aborts only the offending
      thread (the other core is never affected), plus a self-test
      that provokes a guarded write. The guard is programmed at
      runtime into the last MPU region slot with an explicit
      read-only access encoding (a device-tree attribute would be
      silently rewritten to read-write by Kconfig options such as
      MPU_ALLOW_FLASH_WRITE, which SOC_FLASH_MCUX selects). Note:
      ARMv8-M cannot deny privileged reads while the background map
      is enabled, so only cross-core writes fault.

config SYNAPTIC_SHELL
    bool "Enable SynapticOS shell commands"
    depends on SHELL
    default y
    help
      Add shell commands for model management, profiling,
      and runtime inspection.

config SYNAPTIC_LOG_LEVEL
    int "SynapticOS log level"
    default 3
    range 0 4
    help
      0=OFF, 1=ERR, 2=WRN, 3=INF, 4=DBG

endif # SYNAPTIC
```
