## boards/nxp/frdm_mcxn947_cpu1/Kconfig.frdm_mcxn947_cpu1
```kconfig
# SPDX-License-Identifier: Apache-2.0
# Out-of-tree board: FRDM-MCXN947 second core (CPU1).
# Zephyr 3.7's in-tree frdm_mcxn947 board only defines the cpu0
# target; this board provides the cpu1 target for SynapticOS
# asymmetric dual-core operation. CPU0 keeps the stock board.

config BOARD_FRDM_MCXN947_CPU1
	select SOC_MCXN947_CPU1 if BOARD_FRDM_MCXN947_CPU1_MCXN947_CPU1
	select SOC_PART_NUMBER_MCXN947VDF

# Zephyr 3.7's SOC_MCXN947_CPU1 symbol carries no CPU selects
# (upstream only fleshed out CPU0). Merge in the core type here.
# CPU1 is a Cortex-M33 WITHOUT FPU, DSP, TrustZone-M or MPU, so
# none of CPU0's CPU_HAS_* selects apply.
config SOC_MCXN947_CPU1
	select CPU_CORTEX_M33
```

## boards/nxp/frdm_mcxn947_cpu1/frdm_mcxn947_cpu1_mcxn947_cpu1_defconfig
```kconfig
# SPDX-License-Identifier: Apache-2.0
# FRDM-MCXN947 CPU1 (SynapticOS application core)
# Cortex-M33 without FPU/DSP/TrustZone/MPU: no ARM_MPU, no
# HW_STACK_PROTECTION, no TRUSTED_EXECUTION_SECURE here.

# No console hardware for CPU1: single VCOM belongs to CPU0
CONFIG_CONSOLE=n
CONFIG_SERIAL=n
CONFIG_UART_CONSOLE=n

# Private SysTick at the 150 MHz core clock set up by CPU0
CONFIG_CORTEX_M_SYSTICK=y
CONFIG_SYS_CLOCK_HW_CYCLES_PER_SEC=150000000
```

## tests/unit/testcase.yaml
```yaml
tests:
  synaptic.unit:
    tags: synaptic unit
    platform_allow:
      - frdm_mcxn947/mcxn947/cpu0
      - qemu_cortex_m3
```

## tests/unit_store/testcase.yaml
```yaml
tests:
  synaptic.store:
    tags: synaptic store ota
    platform_allow:
      - frdm_mcxn947/mcxn947/cpu0
      - qemu_cortex_m3
```
