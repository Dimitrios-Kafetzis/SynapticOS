/*
 * SynapticOS Device Tree Overlay — CPU0 (AI Core)
 * Configures memory regions, NPU, and IPC.
 */

/ {
    chosen {
        /* Use flexcomm4 for console */
        zephyr,console = &flexcomm4_lpuart4;
        zephyr,shell-uart = &flexcomm4_lpuart4;
    };

    /* Shared memory region for IPC with CPU1 */
    syn_shared_mem: memory@20040000 {
        compatible = "mmio-sram";
        reg = <0x20040000 0x18000>;  /* 96 KB shared region */
    };
};
